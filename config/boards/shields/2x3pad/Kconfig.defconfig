## config/west.yml
```yaml
manifest:
  remotes:
    - name: zmkfirmware
      url-base: https://github.com/zmkfirmware
    - name: zmk-keyboard-hexaboard
      url-base: https://github.com/siliconsniffer
  projects:
    - name: zmk
      remote: zmkfirmware
      revision: main
      import: app/west.yml
    - name: zmk-keyboard-hexaboard
      remote: zmk-keyboard-hexaboard
      revision: master

  self:
    path: config
```
